## build/conf/bblayers.conf
```bitbake
# POKY_BBLAYERS_CONF_VERSION is increased each time build/conf/bblayers.conf
# changes incompatibly
POKY_BBLAYERS_CONF_VERSION = "2"

BBPATH = "${TOPDIR}"
BBFILES ?= ""

BBLAYERS ?= " \
  /home/user/final-project-assignmnent-yarammg/poky/meta \
  /home/user/final-project-assignmnent-yarammg/poky/meta-poky \
  /home/user/final-project-assignmnent-yarammg/poky/meta-yocto-bsp \
  /home/user/final-project-assignmnent-yarammg/meta-openembedded/meta-oe \
  /home/user/final-project-assignmnent-yarammg/meta-tegra \
  /home/user/final-project-assignmnent-yarammg/meta-finalproject \
  "
```
