/dts-v1/;
/plugin/;

/ {
    fragment@0 {
        target = <&gen1_i2c>;
        __overlay__ {
            status = "okay";

            sht3x@44 {
                compatible = "sensirion,sht3x";
                reg = <0x44>;  // I2C address, usually 0x44 or 0x45
            };
        };
    };
};

